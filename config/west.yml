## config/west.yml
```yaml
manifest:
  defaults:
    revision: v0.3
  remotes:
    - name: zmkfirmware
      url-base: https://github.com
    - name: englmaxi
      url-base: https://github.com
  projects:
    - name: zmk
      remote: zmkfirmware
      import: app/west.yml
    - name: zmk-nice-oled
      remote: englmaxi
      repo-path: englmaxi/zmk-nice-oled
      revision: main
  self:
      path: config
```
